## src/mainboard/xunlong/Kconfig
```kconfig
## SPDX-License-Identifier: GPL-2.0-only

if VENDOR_XUNLONG

choice
	prompt "Mainboard model"

source "src/mainboard/xunlong/*/Kconfig.name"

endchoice

source "src/mainboard/xunlong/*/Kconfig"

config MAINBOARD_VENDOR
	default "XunLong"

endif # VENDOR_XUNLONG
```

## src/mainboard/xunlong/opi5plus/Kconfig
```kconfig
## SPDX-License-Identifier: GPL-2.0-only

if BOARD_XUNLONG_ORANGEPI5PLUS

config BOARD_SPECIFIC_OPTIONS
	def_bool y
	select BOARD_ROMSIZE_KB_16384
	select COMMON_CBFS_SPI_WRAPPER
	select SOC_ROCKCHIP_RK3588
	select SPI_FLASH
	select SPI_FLASH_GIGADEVICE

config MAINBOARD_DIR
	default "xunlong/opi5plus"

config BOOT_DEVICE_SPI_FLASH_BUS
	int
	default 1

config CONSOLE_SERIAL_UART_ADDRESS
	hex
	depends on DRIVERS_UART
	default 0xFD890000

##########################################################
#### Update below when adding a new derivative board. ####
##########################################################

config MAINBOARD_PART_NUMBER
	default "OrangePi5Plus" if BOARD_XUNLONG_ORANGEPI5PLUS
endif # BOARD_XUNLONG_ORANGEPI5PLUS
```
